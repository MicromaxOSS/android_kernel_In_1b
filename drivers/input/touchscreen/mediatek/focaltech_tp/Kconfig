## drivers/input/touchscreen/mediatek/focaltech_tp/Kconfig
```kconfig
#
# Touchscreen driver configuration
#
config TOUCHSCREEN_MTK_FOCALTECH_TP
    bool "Focaltech Tp for Mediatek"
    depends on I2C
    default n
    help
      Say Y here if you have Focaltech touch panel.
      If unsure, say N.
      
config TOUCHSCREEN_MTK_FTS_DIRECTORY
    string "Focaltech tp directory name"
    default "focaltech_tp"
    depends on TOUCHSCREEN_MTK_FOCALTECH_TP
    
```

## drivers/misc/mediatek/imgsensor/Kconfig
```kconfig
config MTK_IMGSENSOR
	bool CONFIG_MTK_IMGSENSOR
	default n
	help
	  CONFIG_MTK_IMGSENSOR

config MTK_CAMERA_VCAMIO_ON
	bool "MTK camera vcamio on"
	default n
	help
	  Set Y to enable vcamio on
	  
config MAIN_MAIN2_SHARE_VDDIO
	bool "camera and camera2 share use system vddio"
	default n

source "drivers/misc/mediatek/imgsensor/src/Kconfig"
```
